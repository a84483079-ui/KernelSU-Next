## kernel/Kconfig
```kconfig
menu "KernelSU"

config KSU
	tristate "KernelSU function support"
	depends on KPROBES
	default y
	help
	  Enable kernel-level root privileges on Android System.
	  Requires CONFIG_KPROBES for kernel hooking support.
	  To compile as a module, choose M here: the
	  module will be called kernelsu.

config KSU_DEBUG
	bool "KernelSU debug mode"
	depends on KSU
	default n
	help
	  Enable KernelSU debug mode.

config KSU_GRAPHENEOS_COMPAT
	bool "KernelSU GrapheneOS compat"
	depends on KSU
	default n
	help
	  Enable KernelSU compatibility mode with GrapheneOS.

config KSU_DISABLE_INSTALLATION
	bool "Disable KernelSU hooks and etc"
	depends on KSU
	default n
	help
	  Disable KernelSU installation (skip kprobe installation).

endmenu
```
